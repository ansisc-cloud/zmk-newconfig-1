## zmk/app/west.yml
```yaml
manifest:
  version: 0.13

  remotes:
    - name: zmkfirmware
      url-base: https://github.com/zmkfirmware

  projects:
    - name: zephyr
      remote: zmkfirmware
      revision: main
      import: true

    - name: zmk
      remote: zmkfirmware
      revision: main
      path: app

  self:
    path: app
```
